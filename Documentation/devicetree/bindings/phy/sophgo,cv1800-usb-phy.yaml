## Documentation/devicetree/bindings/phy/sophgo,cv1800-usb-phy.yaml
```yaml
# SPDX-License-Identifier: (GPL-2.0-only OR BSD-2-Clause)
%YAML 1.2
---
$id: http://devicetree.org/schemas/phy/sophgo,cv1800-usb-phy.yaml#
$schema: http://devicetree.org/meta-schemas/core.yaml#

title: Sophgo CV18XX/SG200X USB 2.0 PHY

maintainers:
  - Inochi Amaoto <inochiama@outlook.com>

properties:
  compatible:
    const: sophgo,cv1800-usb-phy

  reg:
    maxItems: 1

  "#phy-cells":
    const: 0

  clocks:
    items:
      - description: PHY clock
      - description: PHY app clock
      - description: PHY stb clock
      - description: PHY lpm clock

  clock-names:
    items:
      - const: phy
      - const: app
      - const: stb
      - const: lpm

  vbus_det-gpios:
    description: GPIO to the USB OTG VBUS detect pin. This should not be
      defined if vbus_det pin and switch pin are connected, which may
      break the VBUS detection.
    maxItems: 1

  sophgo,switch-gpios:
    description: GPIO array for the phy to control connected switch. For
      host mode, the driver will set these GPIOs to low one by one. For
      device mode, the driver will set these GPIOs to high in reverse
      order. For a reference design, see item description.
    minItems: 1
    items:
      - description: USB switch operation mode
      - description: USB switch host power control

required:
  - compatible
  - "#phy-cells"
  - clocks
  - clock-names

additionalProperties: false

examples:
  - |
    phy@48 {
      compatible = "sophgo,cv1800-usb-phy";
      reg = <0x48 0x4>;
      #phy-cells = <0>;
      clocks = <&clk 92>, <&clk 93>,
               <&clk 94>, <&clk 95>;
      clock-names = "phy", "app", "stb", "lpm";
    };

...
```

## Documentation/devicetree/bindings/pwm/sophgo,cv1800-pwm.yaml
```yaml
# SPDX-License-Identifier: (GPL-2.0-only OR BSD-2-Clause)
%YAML 1.2
---
$id: http://devicetree.org/schemas/pwm/sophgo,cv1800-pwm.yaml#
$schema: http://devicetree.org/meta-schemas/core.yaml#

title: Sophgo CV1800 PWM controller

maintainers:
  - Jingbao Qiu <qiujingbao.dlmu@gmail.com>

description:
  The chip provides a set of four independent PWM channel outputs.

allOf:
  - $ref: pwm.yaml#

properties:
  compatible:
    const: sophgo,cv1800-pwm

  reg:
    maxItems: 1

  clocks:
    maxItems: 1

  "#pwm-cells":
    const: 3

required:
  - compatible
  - reg
  - clocks

unevaluatedProperties: false

examples:
  - |
    pwm0: pwm@3060000 {
        compatible = "sophgo,cv1800-pwm";
        reg = <0x3060000 0x1000>;
        clocks = <&clk 60>;
        #pwm-cells = <3>;
    };
```

## Documentation/devicetree/bindings/reset/sophgo,cv1800b-reset.yaml
```yaml
# SPDX-License-Identifier: GPL-2.0-only OR BSD-2-Clause
%YAML 1.2
---
$id: http://devicetree.org/schemas/reset/sophgo,cv1800b-reset.yaml#
$schema: http://devicetree.org/meta-schemas/core.yaml#

title: Sophgo CV1800B SoC Reset Controller

maintainers:
  - Jisheng Zhang <jszhang@kernel.org>

properties:
  compatible:
    enum:
      - sophgo,cv1800b-reset

  reg:
    maxItems: 1

  "#reset-cells":
    const: 1

required:
  - compatible
  - reg
  - "#reset-cells"

additionalProperties: false

examples:
  - |
    reset-controller@3003000 {
        compatible = "sophgo,cv1800b-reset";
        reg = <0x03003000 0x1000>;
        #reset-cells = <1>;
    };

...
```

## Documentation/devicetree/bindings/rtc/sophgo,cv1800-rtc.yaml
```yaml
# SPDX-License-Identifier: (GPL-2.0-only OR BSD-2-Clause)
%YAML 1.2
---
$id: http://devicetree.org/schemas/rtc/sophgo,cv1800-rtc.yaml#
$schema: http://devicetree.org/meta-schemas/core.yaml#

title: Real Time Clock of the Sophgo CV1800 SoC

description:
  Real Time Clock (RTC) is an independently powered module
  within the chip, which includes a 32KHz oscillator and a
  Power On Reset/POR submodule. It can be used for time display
  and timed alarm generation. In addition, the hardware state
  machine provides triggering and timing control for chip
  power on, off, and reset.

maintainers:
  - Jingbao Qiu <qiujingbao.dlmu@gmail.com>

allOf:
  - $ref: rtc.yaml#

properties:
  compatible:
    const: sophgo,cv1800-rtc

  reg:
    maxItems: 1

  interrupts:
    maxItems: 1

  clocks:
    maxItems: 1

required:
  - compatible
  - reg
  - interrupts
  - clocks

unevaluatedProperties: false

examples:
  - |
    #include <dt-bindings/interrupt-controller/irq.h>

    rtc@5025000 {
        compatible = "sophgo,cv1800-rtc";
        reg = <0x5025000 0x2000>;
        interrupts = <17 IRQ_TYPE_LEVEL_HIGH>;
        clocks = <&osc>;
    };
```

## Documentation/devicetree/bindings/spi/sophgo,spi-cv1800-nor.yaml
```yaml
# SPDX-License-Identifier: (GPL-2.0-only OR BSD-2-Clause)
%YAML 1.2
---
$id: http://devicetree.org/schemas/spi/sophgo,spi-cv1800-nor.yaml#
$schema: http://devicetree.org/meta-schemas/core.yaml#

title: SPI controller for Sophgo RISC-V SoCs

maintainers:
  - Jingbao Qiu <qiujingbao.dlmu@gmail.com>

allOf:
  - $ref: /schemas/spi/spi-controller.yaml#

properties:
  compatible:
    const: sophgo,cv1800b-nor

  reg:
    maxItems: 1

required:
  - compatible
  - reg

unevaluatedProperties: false

examples:
  - |
    spi@10000000 {
      compatible = "sophgo,cv1800b-nor";
      reg = <0x10000000 0x10000000>;
    };
```

## Documentation/devicetree/bindings/thermal/sophgo,cv1800-thermal.yaml
```yaml
# SPDX-License-Identifier: (GPL-2.0 OR BSD-2-Clause)
%YAML 1.2
---
$id: http://devicetree.org/schemas/thermal/sophgo,cv1800-thermal.yaml#
$schema: http://devicetree.org/meta-schemas/core.yaml#

title: Sophgo CV1800 on-SoC Thermal Sensor

maintainers:
  - Haylen Chu <heylenay@4d2.org>

description: Sophgo CV1800 on-SoC thermal sensor

$ref: thermal-sensor.yaml#

properties:
  compatible:
    enum:
      - sophgo,cv1800-thermal

  reg:
    maxItems: 1

  clocks:
    maxItems: 1

  interrupts:
    maxItems: 1

  sample-rate-hz:
    minimum: 1
    maximum: 1908
    default: 1

  '#thermal-sensor-cells':
    const: 0

required:
  - compatible
  - reg
  - clocks
  - interrupts

additionalProperties: false

examples:
  - |
    #include <dt-bindings/clock/sophgo,cv1800.h>
    #include <dt-bindings/interrupt-controller/irq.h>
    thermal-sensor@30e0000 {
        compatible = "sophgo,cv1800-thermal";
        reg = <0x30e0000 0x100>;
        clocks = <&clk CLK_TEMPSEN>;
        interrupts = <16 IRQ_TYPE_LEVEL_HIGH>;
        #thermal-sensor-cells = <0>;
    };
...
```

## drivers/tpu/sophgo/Kconfig
```kconfig
# SPDX-License-Identifier: GPL-2.0

config CV1800_TPU
	depends on ARCH_SOPHGO
	tristate "TPU driver for sophgo cv1800"
	help
	  If you say yes here you get support for TPU in Sophgo CV1800 SoC.
```
