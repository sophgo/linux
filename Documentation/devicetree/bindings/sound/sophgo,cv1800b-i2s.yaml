## Documentation/devicetree/bindings/sound/sophgo,cv1800b-i2s.yaml
```yaml
# SPDX-License-Identifier: (GPL-2.0-only OR BSD-2-Clause)
%YAML 1.2
---
$id: http://devicetree.org/schemas/sound/sophgo,cv1800b-i2s.yaml#
$schema: http://devicetree.org/meta-schemas/core.yaml#

title: Sophgo CV1800B I2S/TDM controller

maintainers:
  - Anton D. Stavinskii <stavinsky@gmail.com>

description: |
  I2S/TDM controller found in CV1800B / Sophgo SG2002/SG2000 SoCs.

properties:
  compatible:
    const: sophgo,cv1800b-i2s

  reg:
    maxItems: 1

  "#sound-dai-cells":
    const: 0

  clocks:
    minItems: 1
    maxItems: 2

  clock-names:
    items:
      - const: i2s
      - const: mclk

  dmas:
    maxItems: 2

  dma-names:
    description: |
      Names of DMA channels. May be omitted. If present, one entry
      selects a single direction, while two entries select RX and TX.
    minItems: 1
    maxItems: 2
    items:
      enum: [rx, tx]

  "#address-cells":
    const: 1

  "#size-cells":
    const: 0

required:
  - compatible
  - reg
  - clocks
  - clock-names
  - "#sound-dai-cells"

additionalProperties: false

examples:
  - |
    #include <dt-bindings/clock/sophgo,cv1800.h>

    i2s1: i2s@4110000 {
        compatible = "sophgo,cv1800b-i2s";
        reg = <0x04110000 0x10000>;
        #address-cells = <1>;
        #size-cells = <0>;
        clocks = <&clk CLK_APB_I2S1>,  <&clk CLK_SDMA_AUD1>;
        clock-names = "i2s", "mclk";
        dmas = <&dmamux 2 1>, <&dmamux 3 1>;
        dma-names = "rx", "tx";
    };
...
```

## Documentation/devicetree/bindings/sound/sophgo,cv1800b-sound-adc.yaml
```yaml
# SPDX-License-Identifier: (GPL-2.0-only OR BSD-2-Clause)
%YAML 1.2
---
$id: http://devicetree.org/schemas/sound/sophgo,cv1800b-sound-adc.yaml#
$schema: http://devicetree.org/meta-schemas/core.yaml#

title: Sophgo CV1800B Internal ADC Codec

maintainers:
  - Anton D. Stavinskii <stavinsky@gmail.com>

description: |
  Internal ADC audio codec integrated in the Sophgo CV1800B SoC.
  The codec exposes a single DAI and is intended to be connected
  to an I2S/TDM controller via an ASoC machine driver.

properties:
  compatible:
    const: sophgo,cv1800b-sound-adc

  reg:
    maxItems: 1
    description:
      Base address and size of the ADC register block.

  "#sound-dai-cells":
    const: 0

required:
  - compatible
  - reg
  - "#sound-dai-cells"

additionalProperties: false

examples:
  - |
    audio-codec@300a100 {
      compatible = "sophgo,cv1800b-sound-adc";
      reg = <0x0300a100 0x100>;
      #sound-dai-cells = <0>;
    };
...
```

## Documentation/devicetree/bindings/sound/sophgo,cv1800b-sound-dac.yaml
```yaml
# SPDX-License-Identifier: (GPL-2.0-only OR BSD-2-Clause)
%YAML 1.2
---
$id: http://devicetree.org/schemas/sound/sophgo,cv1800b-sound-dac.yaml#
$schema: http://devicetree.org/meta-schemas/core.yaml#

title: Sophgo CV1800B internal DAC audio codec

maintainers:
  - Anton D. Stavinskii <stavinsky@gmail.com>

description: |
  Internal DAC audio codec integrated in the Sophgo CV1800B SoC.
  The codec exposes a single playback DAI and is intended to be connected to an
  I2S/TDM controller via an ASoC machine driver.

properties:
  compatible:
    const: sophgo,cv1800b-sound-dac

  reg:
    maxItems: 1
    description: |
      Register base address and size of the internal DAC codec register block.

  "#sound-dai-cells":
    const: 0

required:
  - compatible
  - reg
  - "#sound-dai-cells"

additionalProperties: false

examples:
  - |
    audio-codec@300A000  {
        compatible = "sophgo,cv1800b-sound-dac";
        #sound-dai-cells = <0>;
        reg = <0x0300A000 0x100>;
    };
...
```
